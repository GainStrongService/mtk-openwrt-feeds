/dts-v1/;
#include "mt7986a-rfb.dtsi"
/ {
	model = "MediaTek MT7986a RFB";
	compatible = "mediatek,mt7986a-emmc-rfb";

	chosen {
		bootargs = "console=ttyS0,115200n1 loglevel=8  \
				earlycon=uart8250,mmio32,0x11002000 \
				root=/dev/mmcblk0p7 rootfstype=squashfs,f2fs";
	};
};

&snand {
	status = "disabled";
};

&spi0 {
	status = "disabled";
};
