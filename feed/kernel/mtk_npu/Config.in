## feed/kernel/mtk_npu/Config.in
```kconfig
menu "NPU Configurations"
	depends on PACKAGE_kmod-npu

choice
	prompt "NPU Offload Target"
	default MTK_NPU_REBB_SUPPORT
	help
	  Determine NPU offload support target

config MTK_NPU_REBB_SUPPORT
	bool "MTK NPU support ReBB"
	select PACKAGE_npu-rebb-fw

endchoice

source "$(SOURCE)/Config-protocols.in"
source "$(SOURCE)/Config-features.in"

config MTK_NPU_SECURE_FW
	bool "NPU Secure Firmware Load"
	default n
	help
	  Enable NPU secure firmware load

config MTK_NPU_MEM_TEST
	bool "NPU Memory Test"
	depends on !MTK_NPU_SECURE_FW
	default y
	help
	  Set y to execute the memory test during the NPU bring-up process.
	  The memory test will write some of specific patterns to NPU memory,
	  then read it back and compare it to ensure data correctness.
	  This is primarily used to verify the integrity of the memory and its
	  accessibility by the APMCU.

config MTK_NPU_THERMAL
	bool "NPU Thermal"
	default y
	help
	  Set y to enable thermal feature which will automatically throttle
	  NPU usage when the system detects that the board's temperature is
	  too high. The mechanism for throttling NPU usage rate is MCU's
	  dynamic frequency scaling.

config MTK_NPU_LOGGER
	bool "NPU Logger"
	default n
	help
	  Set y to enable logger feature which logs the firmware log to relayfs.
	  Logger feature is runtime turned off by default. To save firmware log
	  for easier debug, logger feature should be further runtime turned on by a
	  user tool (npu-tool's logger) which is responsible to save the firmware log
	  from relayfs to flash.

config MTK_NPU_LOGGER_FW_DEFAULT_RUNNING
	bool "NPU Logger Firmware Default Running"
	depends on MTK_NPU_LOGGER
	default n
	help
	  Set y to turn on firmware logger feature by default. It's mainly used to
	  capture the firmware's cold boot log. If there's no need to capture it,
	  please set n.

config MTK_NPU
	bool
	depends on PACKAGE_kmod-npu

config MTK_NPU_HNAT
	bool
	depends on PACKAGE_kmod-npu-nf_hnat
	help
	  Set y to enable NPU tunnel offload feature with HNAT support. These
	  two hardware features cooperatively offload tunnel packets from Host
	  CPU and accelerate tunnel packets Tx/Rx throughput dramatically.

config MTK_NPU_FLOW
	bool
	depends on PACKAGE_kmod-npu-flow
	help
	  Set y to enable NPU tunnel offload feature with flowblock support. These
	  two hardware features cooperatively offload tunnel packets from Host
	  CPU and accelerate tunnel packets Tx/Rx throughput dramatically.

config MTK_NPU_MCAST
	bool
	depends on PACKAGE_kmod-npu-mcast
	help
	  set y to enable NPU network offload feature with IPv4/IPv6 multicast
	  support.

config MTK_NPU_DPDK
	bool
	depends on PACKAGE_kmod-npu-dpdk
	help
	  set y to enable NPU network offload feature with DPDK customized
	  function. Note that, this feature does not compatible with other NPU
	  features.

choice
	prompt "MTK NPU DPDK MAC Filter entry num"
	depends on MTK_NPU_DPDK
	default MTK_NPU_DPDK_MAC_FILTER_NUM_1024
	help
	  set number of entries that NPU is able to support DPDK MAC filter
	  feature.

config MTK_NPU_DPDK_MAC_FILTER_NUM_1024
	bool "Reserve 1024 entries for mac filter table"

config MTK_NPU_DPDK_MAC_FILTER_NUM_128
	bool "Reserve 128 entries for mac filter table"

endchoice

config MTK_NPU_DPDK_MAC_FILTER_NUM
	int
	depends on MTK_NPU_DPDK
	default 1024 if MTK_NPU_DPDK_MAC_FILTER_NUM_1024
	default 128  if MTK_NPU_DPDK_MAC_FILTER_NUM_128

config MTK_NPU_STATISTIC
	bool "MTK NPU support statistic for various subsystems"
	default y
	help
	  set y to enable NPU to collect its subsystem's status.
endmenu
```

## feed/kernel/mtk_npu/src/Kconfig
```kconfig
config MTK_NPU_SUPPORT
	bool "Mediatek Network Processor Unit Support"
	help
	  Support for Mediatek Network Processor Unit which offloads network
	  operations from APMCU. The subsystem supports tunnel protocols
	  offload, such as GRE, VxLAN, L2TP, PPTP etc., and other network
	  features, such as multicast, L4S, from host CPU.

config MTK_NPU_GRE
	depends on MTK_NPU_SUPPORT
	bool
	help
	  Support for GRE offload to Mediatek Network Processor Unit.
	  Alleviate host CPU's loading by offloading GRE related encapulation
	  and decapulation to NPU.

config MTK_NPU_GRETAP
	depends on MTK_NPU_SUPPORT
	select MTK_NPU_GRE
	bool "Mediatek NPU L2oGRE Offload Support"
	help
	  Support for L2oGRE offload to Mediatek Network Processor Unit.
	  Alleviate host CPU's loading by offloading L2oGRE encapulation and
	  decapulation to NPU.

config MTK_NPU_PPTP
	depends on MTK_NPU_SUPPORT
	bool "Mediatek NPU PPTP Offload Support"
	help
	  Support for PPTP offload to Mediatek Network Processor Unit.
	  Alleviate host CPU's loading by offloading PPTP encapulation and
	  decapulation to NPU.

config MTK_NPU_L2TP
	depends on MTK_NPU_SUPPORT
	bool
	help
	  Support for L2TP offload to Mediatek Network Processor Unit.
	  Alleviate host CPU's loading by offloading L2TP related encapulation
	  and decapulation to NPU.

config MTK_NPU_IP_L2TP
	depends on MTK_NPU_SUPPORT
	select MTK_NPU_L2TP
	bool "Mediatek NPU IP L2TP Offload Support"
	help
	  Support for IP L2TP offload to Mediatek Network Processor Unit.
	  Alleviate host CPU's loading by offloading IP L2TP encapulation and
	  decapulation to NPU.

config MTK_NPU_UDP_L2TP_CTRL
	depends on MTK_NPU_SUPPORT
	select MTK_NPU_L2TP
	bool "Mediatek NPU UDP L2TP Control Offload Support"
	help
	  Support for UDP L2TP control offload to Mediatek Network Processor
	  Unit. Alleviate host CPU's loading by offloading UDP L2TP control
	  encapulation and decapulation to NPU.

config MTK_NPU_UDP_L2TP_DATA
	depends on MTK_NPU_SUPPORT
	select MTK_NPU_L2TP
	bool "Mediatek NPU UDP L2TP Data Offload Support"
	help
	  Support for UDP L2TP data offload to Mediatek Network Processor
	  Unit. Alleviate host CPU's loading by offloading UDP L2TP data
	  encapulation and decapulation to NPU.

config MTK_NPU_VXLAN
	depends on MTK_NPU_SUPPORT
	bool "Mediatek NPU VxLAN Offload Support"
	help
	  Support for VxLAN offload to Mediatek Network Processor Unit.
	  Alleviate host CPU's loading by offloading VxLAN encapulation and
	  decapulation to NPU.

config MTK_NPU_NATT
	depends on MTK_NPU_SUPPORT
	bool "Mediatek NPU NAT Traversal Offload Support"
	help
	  Support for NATT offload to Mediatek Network Processor Unit.
	  Alleviate host CPU's loading by offloading NATT encapulation and
	  decapulation to NPU.

config MTK_NPU_CAPWAP
	depends on MTK_NPU_SUPPORT
	bool
	help
	  Support for CAPWAP offload to Mediatek Network Processor Unit.
	  Alleviate host CPU's loading by offloading CAPWAP related
	  encapulation and decapulation to NPU.

config MTK_NPU_CAPWAP_CTRL
	depends on MTK_NPU_SUPPORT
	select MTK_NPU_CAPWAP
	bool "Mediatek NPU CAPWAP Control Offload Support"
	help
	  Support for CAPWAP control offload to Mediatek Network Processor
	  Unit. Alleviate host CPU's loading by offloading CAPWAP control
	  encapulation and decapulation to NPU.

config MTK_NPU_CAPWAP_DATA
	depends on MTK_NPU_SUPPORT
	select MTK_NPU_CAPWAP
	bool "Mediatek NPU CAPWAP Data Offload Support"
	help
	  Support for CAPWAP data offload to Mediatek Network Processor
	  Unit. Alleviate host CPU's loading by offloading CAPWAP data
	  encapulation and decapulation to NPU.

config MTK_NPU_CAPWAP_DTLS
	depends on MTK_NPU_SUPPORT
	select MTK_NPU_CAPWAP
	bool "Mediatek NPU CAPWAP DTLS Offload Support"
	help
	  Support for CAPWAP DTLS offload to Mediatek Network Processor
	  Unit. Alleviate host CPU's loading by offloading CAPWAP DTLS
	  encapulation and decapulation to NPU.

config MTK_NPU_IPSEC
	depends on MTK_NPU_SUPPORT
	bool
	help
	  Support for IPSEC offload to Mediatek Network Processor Unit.
	  Alleviate host CPU's loading by offloading IPSEC related
	  encapulation and decapulation to NPU.

config MTK_NPU_IPSEC_ESP
	depends on MTK_NPU_SUPPORT
	select MTK_NPU_IPSEC
	bool "Mediatek NPU IPSec ESP Offload Support"
	help
	  Support for IPSec ESP offload to Mediatek Network Processor
	  Unit. Alleviate host CPU's loading by offloading IPSec ESP
	  encapulation and decapulation to NPU.

config MTK_NPU_IPSEC_AH
	depends on MTK_NPU_SUPPORT
	select MTK_NPU_IPSEC
	bool "Mediatek NPU IPSec AH Offload Support"
	help
	  Support for IPSec AH offload to Mediatek Network Processor
	  Unit. Alleviate host CPU's loading by offloading IPSec AH
	  encapulation and decapulation to NPU.

config MTK_NPU_TRUSTSEC
	depends on MTK_NPU_SUPPORT
	bool "Mediatek NPU TrustSec Offload Support"
	help
	  Support for TrustSec offload to Mediatek Network Processor
	  Unit. Alleviate host CPU's loading by offloading TrustSec
	  encapulation and decapulation to NPU.

config NPU_TNL_NUM
	int "Mediatek NPU Tunnel Count"
	depends on MTK_NPU_SUPPORT
	help
	  Configuration for tunnel count for Network Processor Unit.
	  This value should be 2 ^ NPU_TNL_MAP_BIT.

config NPU_TNL_MAP_BIT
	int "Mediatek NPU Tunnel Map Bit"
	depends on MTK_NPU_SUPPORT
	help
	  Configuration for tunnel map bit for Network Processor Unit.
	  This value is log of NPU_TNL_NUM.

config NPU_FLOW_NUM
	int "Mediatek NPU Flow Count"
	depends on MTK_NPU_SUPPORT
	help
	  Configuration for flow count for Network Processor Unit.

config MTK_NPU_FLOW
	bool
	help
	 Configuration for flow feature for Network Processor Unit

config MTK_NPU_IAP_SUPPORT
	bool
	help
	 Configuration for MediaTek NPU support for IAP applications.

config MTK_NPU_CCN71_SUPPORT
	bool
	help
	 Configuration for MediaTek NPU support for CCN71 applications.

config MTK_NPU_SELECT_NETSYS_PATH_MODE_SUPPORT
	bool
	help
	 Configuration for NPU support for selecting netsys path mode.
```

## package-21.02/kernel/tops/Config.in
```kconfig
menu "TOPS configuration"
	depends on PACKAGE_kmod-tops

source "Config-protocols.in"

choice
	prompt "TOPS Tunnel Count"
	default TOPS_TNL_32
	help
	  Determine number of TOPS tunnel

config TOPS_TNL_32
	bool "32 TOPS Tunnel"

endchoice

choice
	prompt "TOPS Firmware Target"
	default MTK_TOPS_FIRMWARE_RELEASE
	help
	  Select TOPS firmware target. Either release or latest firmware

config MTK_TOPS_FIRMWARE_RELEASE
	bool "MTK TOPS Firmware Release Build"
	select PACKAGE_tops-rebb-fw-release

config MTK_TOPS_FIRMWARE_LATEST
	bool "MTK TOPS Firmware Latest Build"
	select PACKAGE_tops-rebb-fw

endchoice

config MTK_TOPS_SECURE_FW
	bool "TOPS Secure Firmware Load"
	default n
	help
	  Enable TOPS secure firmware load

config TOPS_TNL_NUM
	int
	default 32 if TOPS_TNL_32
	help
	  Configuration for TOPS tunnel count. This value should be
	  2 ^ TOPS_TNL_MAP_BIT.

config TOPS_TNL_MAP_BIT
	int
	default 5 if TOPS_TNL_32
	help
	  Configuration for TOPS tunnel map bit. This value should be the log
	  of TOPS_TNL_NUM.

endmenu
```
