/* SPDX-License-Identifier: (GPL-2.0 OR MIT) */

/dts-v1/;
#include "mt7987a.dtsi"
#include "mt7987-netsys-gmac123.dtsi"
#include "mt7987-spim-nor.dtsi"

/ {
	model = "MediaTek MT7987 NOR RFB";
	compatible = "mediatek,mt7987a-spim-nor",
		     "mediatek,mt7987a", "mediatek,mt7987";

	chosen {
		bootargs = "console=ttyS0,115200n1 loglevel=8  \
			    earlycon=uart8250,mmio32,0x11000000 \
			    pci=pcie_bus_perf";
	};
};
