// SPDX-License-Identifier: (GPL-2.0 OR MIT)

#include <dt-bindings/phy/phy.h>

&tphyu3port0 {
	status = "okay";
};

&ssusb {
	mediatek,u3p-dis-msk=<0>;
	phys = <&tphyu2port0 PHY_TYPE_USB2>,
	       <&tphyu3port0 PHY_TYPE_USB3>;
};

