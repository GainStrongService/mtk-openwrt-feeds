## autobuild/unified/filogic/mac80211/mt798x_rfb/wifi6_nic/25.12/defconfig
```kconfig
# CONFIG_TARGET_DEVICE_mediatek_filogic_DEVICE_bananapi_bpi-r4 is not set
# CONFIG_TARGET_DEVICE_mediatek_filogic_DEVICE_bananapi_bpi-r4-poe is not set
# CONFIG_TARGET_DEVICE_mediatek_filogic_DEVICE_bananapi_bpi-r4-lite is not set
# CONFIG_TARGET_DEVICE_mediatek_filogic_DEVICE_bananapi_bpi-r4-pro is not set
# CONFIG_TARGET_DEVICE_mediatek_filogic_DEVICE_mediatek_mt7987a-rfb is not set
# CONFIG_TARGET_DEVICE_mediatek_filogic_DEVICE_mediatek_mt7988a-rfb is not set
# CONFIG_TARGET_DEVICE_mediatek_filogic_DEVICE_mediatek_mt7988a-rfb-mxl86252 is not set
# CONFIG_TARGET_DEVICE_mediatek_filogic_DEVICE_mediatek_mt7988d-rfb is not set
CONFIG_PACKAGE_mt7986-wo-firmware=y
CONFIG_PACKAGE_mt7988-wo-firmware=m
# CONFIG_PACKAGE_kmod-gpio-pca953x is not set
CONFIG_PACKAGE_kmod-hwmon-pwmfan=m
CONFIG_PACKAGE_kmod-i2c-mux-pca954x=m
CONFIG_PACKAGE_kmod-eeprom-at24=m
CONFIG_PACKAGE_kmod-rtc-pcf8563=m
# CONFIG_PACKAGE_CFG80211_TESTMODE is not set
# CONFIG_PACKAGE_kmod-mt7996-233-firmware is not set
# CONFIG_PACKAGE_kmod-mt7996-firmware is not set
# CONFIG_PACKAGE_kmod-mt7996e is not set
CONFIG_PACKAGE_kmod-crypto-eip-ddk=y
CONFIG_PACKAGE_kmod-pce=y
CONFIG_PACKAGE_strongswan=y
CONFIG_PACKAGE_strongswan-default=y
CONFIG_PACKAGE_strongswan-mod-kdf=y
```

## autobuild/unified/filogic/master/defconfig
```kconfig
CONFIG_TARGET_MULTI_PROFILE=y
CONFIG_TARGET_PER_DEVICE_ROOTFS=y
CONFIG_TARGET_DEVICE_mediatek_filogic_DEVICE_bananapi_bpi-r4-lite=y
CONFIG_TARGET_DEVICE_mediatek_filogic_DEVICE_bananapi_bpi-r4-pro=y
CONFIG_TARGET_DEVICE_mediatek_filogic_DEVICE_mediatek_mt7987a-rfb=y
CONFIG_TARGET_DEVICE_mediatek_filogic_DEVICE_mediatek_mt7988a-rfb=y
CONFIG_TARGET_DEVICE_mediatek_filogic_DEVICE_mediatek_mt7988a-rfb-mxl86252=y
CONFIG_TARGET_DEVICE_mediatek_filogic_DEVICE_mediatek_mt7988d-rfb=y
CONFIG_COLLECT_KERNEL_DEBUG=y
# CONFIG_KERNEL_DEBUG_INFO_REDUCED is not set
CONFIG_DEBUG=y
CONFIG_PACKAGE_mt7981-wo-firmware=y
CONFIG_PACKAGE_mt798x-2p5g-phy-firmware-internal=y
CONFIG_PACKAGE_kmod-phy-aquantia=y
CONFIG_PACKAGE_kmod-sfp=y
CONFIG_PACKAGE_kmod-mt7915e=y
CONFIG_PACKAGE_kmod-mt7981-firmware=y
CONFIG_PACKAGE_ephy-utils=y
CONFIG_PACKAGE_ethtool-full=y
CONFIG_PACKAGE_fio=y
CONFIG_PACKAGE_lsblk=y
CONFIG_PACKAGE_sfdisk=y
CONFIG_PACKAGE_mmc-utils=y
```

## autobuild/unified/global/common/files/package/utils/swupdate/src/configs/mtk_defconfig
```kconfig
CONFIG_SIGNED_IMAGES=y
CONFIG_SIGALG_RSAPSS=y
CONFIG_RAW=y
CONFIG_CFI=y
CONFIG_DISKPART=y
CONFIG_UBIVOL=y
```
