## 24.10/files/package/mtk/optee-mediatek/config/Config.in
```kconfig
menu "OP-TEE Configuration"
	depends on PACKAGE_optee-mediatek

source "Config-optee-os.in"
source "Config-optee-client.in"
source "Config-optee-mtk.in"

	config OPTEE_TEST
		bool "Build OP-TEE xtest"
		select OPTEE_ENABLE_EMBEDDED_TESTS
		select OPTEE_TA_TEST_PATH
		default n
		help
		  Build optee_test to build xtest, and related TAs
endmenu
```

## 25.12/files/package/mtk/optee/optee-apps/Config.in
```kconfig
menu "OP-TEE MTK Configuration"
	depends on PACKAGE_optee-apps
	config OPTEE_MTK_SECURE_STORAGE
		bool "Enable secure storage example"
		default n
		help
		  Enable secure storage host/TA example to manipulate OP-TEE storage
		  by using user space commands, including read/write/delete/rename/list
		  operations, mainly for testing purpose

	config OPTEE_MTK_RNG
		bool "Enable random number generator(RNG) command"
		default n
		help
		  Enable random number generator(RNG) host example to get random
		  number from OP-TEE OS by using user space commands, mainly for
		  testing purpose

	config OPTEE_FW_ENC_EARLY_TA
		bool "OPTEE Firmware Encryption early TA"
		default n
		select OPTEE_EARLY_TA

	config OPTEE_RUST_TA_HOST
		bool "Enable support for building TA/host written in Rust(Experimental)"
		default n
endmenu
```

## 25.12/files/package/mtk/optee/optee-test/Config.in
```kconfig
menu "OP-TEE Test Configuration"
	depends on PACKAGE_optee-test
	config OPTEE_MTK_TEST
		bool "Enable MTK Testsuite"
		select OPTEE_TEST
		select OPTEE_MTK_SECURE_STORAGE
		select OPTEE_MTK_RNG
		default n

	config OPTEE_MTK_TEE_FUZZER
		bool "Enable MTK TEE FUZZER"
		default n
		depends on OPTEE_MTK_TEST

	config OPTEE_MTK_TEST_FIPS
		bool "Enable MTK FIPS test interface"
		default n
		depends on OPTEE_MTK_TEST
endmenu
```

## autobuild/unified/filogic/24.10/files/target/linux/mediatek/image/Config.in
```kconfig
menuconfig MTK_SECURE_BOOT
	bool "Enable Secure Boot"
	select PACKAGE_dmsetup
	select PACKAGE_cryptsetup
	default n
	help
	  Select mtk secure boot

if MTK_SECURE_BOOT

config SBC_KEY_DIR
	string "secure boot key directory"
	default "../../keys"

config FIT_SIGN_KEY_NAME
	string "FIT sign key name"
	default "fit_key"

config FIT_SIGN_ALG
	string "FIT sign algorithm"
	default "sha256,rsa2048"

endif # MTK_SECURE_BOOT
```

## autobuild/unified/filogic/mac80211/24.10/defconfig
```kconfig
CONFIG_KERNEL_PROFILING=y
CONFIG_KERNEL_BPF_EVENTS=y
CONFIG_DEVEL=y
CONFIG_BUSYBOX_CONFIG_TELNET=y
CONFIG_BUSYBOX_CONFIG_TELNETD=y
CONFIG_BUSYBOX_CONFIG_FEATURE_TELNETD_STANDALONE=y
CONFIG_PACKAGE_flex=m
CONFIG_PACKAGE_mt76-test=y
CONFIG_PACKAGE_perf=y
# CONFIG_PACKAGE_mt7981-wo-firmware is not set
# CONFIG_PACKAGE_mt7986-wo-firmware is not set
CONFIG_PACKAGE_mt7988-wo-firmware=y
CONFIG_PACKAGE_kmod-br-netfilter=y
CONFIG_PACKAGE_CFG80211_TESTMODE=y
# CONFIG_PACKAGE_kmod-mt7915e is not set
# CONFIG_PACKAGE_kmod-mt7981-firmware is not set
# CONFIG_PACKAGE_kmod-mt7986-firmware is not set
CONFIG_PACKAGE_kmod-mt7990-firmware=y
CONFIG_PACKAGE_kmod-mt7992-23-firmware=y
CONFIG_PACKAGE_kmod-mt7992-firmware=y
CONFIG_PACKAGE_kmod-mt7996-233-firmware=y
CONFIG_PACKAGE_luci-app-omcproxy=y
CONFIG_PACKAGE_atenl=y
CONFIG_PACKAGE_netfilter-flowtable=y
CONFIG_PACKAGE_iptables-mod-conntrack-extra=y
CONFIG_PACKAGE_iptables-mod-extra=y
CONFIG_PACKAGE_afcd=y
CONFIG_PACKAGE_hostapd-utils=y
CONFIG_PACKAGE_wpa-cli=y
CONFIG_WPA_MSG_MIN_PRIORITY=2
CONFIG_PACKAGE_iperf3=y
# CONFIG_PACKAGE_iw is not set
CONFIG_PACKAGE_iw-full=y
CONFIG_PACKAGE_smp_util=y
```

## autobuild/unified/filogic/mac80211/bpi/master/defconfig
```kconfig
CONFIG_TARGET_DEVICE_mediatek_filogic_DEVICE_bananapi_bpi-r3=y
CONFIG_TARGET_DEVICE_mediatek_filogic_DEVICE_bananapi_bpi-r3-mini=y
CONFIG_TARGET_DEVICE_mediatek_filogic_DEVICE_bananapi_bpi-r4=y
CONFIG_TARGET_DEVICE_mediatek_filogic_DEVICE_bananapi_bpi-r4-poe=y
# CONFIG_TARGET_DEVICE_mediatek_filogic_DEVICE_mediatek_mt7981-rfb is not set
# CONFIG_TARGET_DEVICE_mediatek_filogic_DEVICE_mediatek_mt7986a-rfb-nand is not set
# CONFIG_TARGET_DEVICE_mediatek_filogic_DEVICE_mediatek_mt7988a-rfb is not set
# CONFIG_TARGET_DEVICE_mediatek_filogic_DEVICE_mediatek_mt7986b-rfb is not set
CONFIG_KERNEL_PROFILING=y
CONFIG_KERNEL_KPROBES=y
CONFIG_PACKAGE_trusted-firmware-a-mt7981-ram-ddr3=y
CONFIG_PACKAGE_trusted-firmware-a-mt7981-ram-ddr4=y
CONFIG_PACKAGE_trusted-firmware-a-mt7986-ram-ddr3=y
CONFIG_PACKAGE_trusted-firmware-a-mt7986-ram-ddr4=y
CONFIG_PACKAGE_trusted-firmware-a-mt7988-ram-comb=y
CONFIG_PACKAGE_perf=y
# CONFIG_PACKAGE_mt7981-wo-firmware is not set
CONFIG_PACKAGE_CFG80211_TESTMODE=y
# CONFIG_PACKAGE_kmod-mt7981-firmware is not set
CONFIG_WPA_MSG_MIN_PRIORITY=3
CONFIG_WPA_ENABLE_WEP=y
# CONFIG_PACKAGE_wpad-basic-openssl is not set
CONFIG_PACKAGE_wpad-openssl=y
CONFIG_PACKAGE_omcproxy=y
CONFIG_PACKAGE_blkid=y
```

## autobuild/unified/filogic/mac80211/bpi/r4/24.10/defconfig
```kconfig
CONFIG_TARGET_DEVICE_mediatek_filogic_DEVICE_bananapi_bpi-r4=y
CONFIG_TARGET_DEVICE_mediatek_filogic_DEVICE_bananapi_bpi-r4-poe=y
# CONFIG_TARGET_DEVICE_mediatek_filogic_DEVICE_mediatek_mt7981-rfb is not set
# CONFIG_TARGET_DEVICE_mediatek_filogic_DEVICE_mediatek_mt7986a-rfb-nand is not set
# CONFIG_TARGET_DEVICE_mediatek_filogic_DEVICE_mediatek_mt7988a-rfb is not set
# CONFIG_TARGET_DEVICE_mediatek_filogic_DEVICE_mediatek_mt7986b-rfb is not set
# CONFIG_TARGET_ROOTFS_INITRAMFS is not set
CONFIG_PACKAGE_trusted-firmware-a-mt7988-ram-comb=y
# CONFIG_PACKAGE_mt7981-wo-firmware is not set
# CONFIG_PACKAGE_mt7986-wo-firmware is not set
# CONFIG_PACKAGE_kmod-mt7915e is not set
# CONFIG_PACKAGE_kmod-mt7981-firmware is not set
# CONFIG_PACKAGE_kmod-mt7986-firmware is not set
CONFIG_WPA_MSG_MIN_PRIORITY=3
CONFIG_WPA_ENABLE_WEP=y
# CONFIG_PACKAGE_wpad-basic-openssl is not set
CONFIG_PACKAGE_wpad-openssl=y
CONFIG_PACKAGE_blkid=y
```

## autobuild/unified/filogic/mac80211/master/defconfig
```kconfig
CONFIG_DEVEL=y
CONFIG_BPF_TOOLCHAIN_BUILD_LLVM=y
CONFIG_PACKAGE_bridger=y
CONFIG_PACKAGE_kmod-mt76=y
CONFIG_PACKAGE_kmod-mt7992-23-firmware=y
CONFIG_PACKAGE_kmod-mt7992-firmware=y
CONFIG_PACKAGE_kmod-mt7996-233-firmware=y
CONFIG_PACKAGE_iptables-mod-conntrack-extra=y
CONFIG_PACKAGE_hostapd-utils=y
CONFIG_PACKAGE_wpa-cli=y
CONFIG_WPA_MSG_MIN_PRIORITY=2
# CONFIG_PACKAGE_wpad-basic-mbedtls is not set
CONFIG_PACKAGE_wpad-basic-openssl=y
CONFIG_PACKAGE_iperf3=y
# CONFIG_PACKAGE_iw is not set
CONFIG_PACKAGE_iw-full=y
```

## autobuild/unified/filogic/mac80211/mozart/24.10/defconfig
```kconfig
CONFIG_TARGET_DEVICE_mediatek_filogic_DEVICE_arcadyan_mozart=y
# CONFIG_PACKAGE_kmod-mt7990-firmware is not set
# CONFIG_PACKAGE_kmod-mt7992-23-firmware is not set
# CONFIG_PACKAGE_kmod-mt7992-firmware is not set
```

## autobuild/unified/filogic/mac80211/mozart/25.12/defconfig
```kconfig
CONFIG_TARGET_DEVICE_mediatek_filogic_DEVICE_arcadyan_mozart=y
# CONFIG_TARGET_DEVICE_mediatek_filogic_DEVICE_bananapi_bpi-r4 is not set
# CONFIG_TARGET_DEVICE_mediatek_filogic_DEVICE_bananapi_bpi-r4-poe is not set
# CONFIG_TARGET_DEVICE_mediatek_filogic_DEVICE_bananapi_bpi-r4-lite is not set
# CONFIG_TARGET_DEVICE_mediatek_filogic_DEVICE_bananapi_bpi-r4-pro is not set
# CONFIG_TARGET_DEVICE_mediatek_filogic_DEVICE_mediatek_mt7987a-rfb is not set
# CONFIG_TARGET_DEVICE_mediatek_filogic_DEVICE_mediatek_mt7988a-rfb is not set
# CONFIG_TARGET_DEVICE_mediatek_filogic_DEVICE_mediatek_mt7988a-rfb-mxl86252 is not set
# CONFIG_TARGET_DEVICE_mediatek_filogic_DEVICE_mediatek_mt7988d-rfb is not set
CONFIG_PACKAGE_kmod-gpio-pca953x=m
CONFIG_PACKAGE_kmod-i2c-mux-pca954x=m
CONFIG_PACKAGE_kmod-eeprom-at24=m
CONFIG_PACKAGE_kmod-rtc-pcf8563=m
CONFIG_PACKAGE_kmod-usb3=m
# CONFIG_PACKAGE_kmod-mt7990-firmware is not set
# CONFIG_PACKAGE_kmod-mt7992-23-firmware is not set
# CONFIG_PACKAGE_kmod-mt7992-firmware is not set
CONFIG_PACKAGE_kmod-crypto-eip-ddk=y
CONFIG_PACKAGE_kmod-pce=y
CONFIG_PACKAGE_strongswan=y
CONFIG_PACKAGE_strongswan-default=y
CONFIG_PACKAGE_strongswan-mod-kdf=y
CONFIG_PACKAGE_blkid=m
```

## autobuild/unified/filogic/mac80211/mozart/master/defconfig
```kconfig
# CONFIG_TARGET_DEVICE_mediatek_filogic_DEVICE_mediatek_mt7981-rfb is not set
# CONFIG_TARGET_DEVICE_mediatek_filogic_DEVICE_mediatek_mt7986a-rfb-nand is not set
# CONFIG_TARGET_DEVICE_mediatek_filogic_DEVICE_mediatek_mt7988a-rfb is not set
# CONFIG_TARGET_DEVICE_mediatek_filogic_DEVICE_mediatek_mt7986b-rfb is not set
CONFIG_TARGET_DEVICE_mediatek_filogic_DEVICE_mediatek_mt7988a-prpl-mozart=y
# CONFIG_PACKAGE_mt7981-wo-firmware is not set
# CONFIG_PACKAGE_mt7986-wo-firmware is not set
CONFIG_PACKAGE_mt7988-2p5g-phy-firmware=y
CONFIG_PACKAGE_kmod-sfp=y
CONFIG_PACKAGE_kmod-usb3=y
# CONFIG_PACKAGE_kmod-mt7915e is not set
# CONFIG_PACKAGE_kmod-mt7981-firmware is not set
# CONFIG_PACKAGE_kmod-mt7986-firmware is not set
# CONFIG_PACKAGE_kmod-mt7992-23-firmware is not set
# CONFIG_PACKAGE_kmod-mt7992-firmware is not set
CONFIG_PACKAGE_xl2tpd=y
CONFIG_PACKAGE_ppp-mod-pptp=y
CONFIG_PACKAGE_e2fsprogs=y
CONFIG_PACKAGE_f2fsck=y
CONFIG_PACKAGE_mkf2fs=y
```

## autobuild/unified/filogic/mac80211/mt7987_rfb/24.10/defconfig
```kconfig
CONFIG_TARGET_PER_DEVICE_ROOTFS=y
CONFIG_TARGET_DEVICE_mediatek_filogic_DEVICE_bananapi_bpi-r4-lite=y
# CONFIG_TARGET_DEVICE_mediatek_filogic_DEVICE_mediatek_mt7981-rfb is not set
# CONFIG_TARGET_DEVICE_mediatek_filogic_DEVICE_mediatek_mt7986a-rfb-nand is not set
CONFIG_TARGET_DEVICE_mediatek_filogic_DEVICE_mediatek_mt7987a-rfb=y
# CONFIG_TARGET_DEVICE_mediatek_filogic_DEVICE_mediatek_mt7988a-rfb is not set
# CONFIG_TARGET_DEVICE_mediatek_filogic_DEVICE_mediatek_mt7986b-rfb is not set
CONFIG_PACKAGE_mt798x-2p5g-phy-firmware-internal=y
# CONFIG_PACKAGE_kmod-crypto-deflate is not set
# CONFIG_PACKAGE_kmod-crypto-echainiv is not set
# CONFIG_PACKAGE_kmod-ipt-ipsec is not set
CONFIG_PACKAGE_kmod-sfp=y
# CONFIG_PACKAGE_kmod-ipsec is not set
# CONFIG_PACKAGE_kmod-iptunnel6 is not set
CONFIG_PACKAGE_kmod-usb3=y
# CONFIG_PACKAGE_libgmp is not set
# CONFIG_PACKAGE_kmod-crypto-eip-ddk is not set
# CONFIG_PACKAGE_kmod-pce is not set
# CONFIG_PACKAGE_iptables-mod-ipsec is not set
# CONFIG_PACKAGE_strongswan is not set
CONFIG_PACKAGE_wpad-basic-mbedtls=m
CONFIG_PACKAGE_blkid=m
CONFIG_PACKAGE_e2fsprogs=y
CONFIG_PACKAGE_f2fsck=y
CONFIG_PACKAGE_mkf2fs=y
```

## autobuild/unified/filogic/mac80211/mt7987_rfb/25.12/defconfig
```kconfig
# CONFIG_TARGET_DEVICE_mediatek_filogic_DEVICE_bananapi_bpi-r4 is not set
# CONFIG_TARGET_DEVICE_mediatek_filogic_DEVICE_bananapi_bpi-r4-poe is not set
# CONFIG_TARGET_DEVICE_mediatek_filogic_DEVICE_bananapi_bpi-r4-pro is not set
# CONFIG_TARGET_DEVICE_mediatek_filogic_DEVICE_mediatek_mt7988a-rfb is not set
# CONFIG_TARGET_DEVICE_mediatek_filogic_DEVICE_mediatek_mt7988a-rfb-mxl86252 is not set
# CONFIG_TARGET_DEVICE_mediatek_filogic_DEVICE_mediatek_mt7988d-rfb is not set
CONFIG_PACKAGE_kmod-usb3=y
CONFIG_PACKAGE_kmod-mt7996-firmware=m
CONFIG_PACKAGE_kmod-crypto-eip-ddk=y
CONFIG_PACKAGE_kmod-pce=y
CONFIG_PACKAGE_strongswan=y
CONFIG_PACKAGE_strongswan-default=y
CONFIG_PACKAGE_strongswan-mod-kdf=y
CONFIG_PACKAGE_e2fsprogs=y
CONFIG_PACKAGE_f2fsck=y
CONFIG_PACKAGE_mkf2fs=y
```

## autobuild/unified/filogic/mac80211/mt7987_rfb/master/defconfig
```kconfig
CONFIG_TARGET_PER_DEVICE_ROOTFS=y
CONFIG_TARGET_DEVICE_mediatek_filogic_DEVICE_bananapi_bpi-r4-lite=y
# CONFIG_TARGET_DEVICE_mediatek_filogic_DEVICE_mediatek_mt7981-rfb is not set
# CONFIG_TARGET_DEVICE_mediatek_filogic_DEVICE_mediatek_mt7986a-rfb-nand is not set
CONFIG_TARGET_DEVICE_mediatek_filogic_DEVICE_mediatek_mt7987a-rfb=y
# CONFIG_TARGET_DEVICE_mediatek_filogic_DEVICE_mediatek_mt7988a-rfb is not set
# CONFIG_TARGET_DEVICE_mediatek_filogic_DEVICE_mediatek_mt7986b-rfb is not set
CONFIG_PACKAGE_mt798x-2p5g-phy-firmware-internal=y
CONFIG_PACKAGE_kmod-sfp=y
CONFIG_PACKAGE_kmod-usb3=y
CONFIG_PACKAGE_blkid=m
CONFIG_PACKAGE_e2fsprogs=y
CONFIG_PACKAGE_f2fsck=y
CONFIG_PACKAGE_mkf2fs=y
```

## autobuild/unified/filogic/mac80211/mt7987_rfb/mt7990/25.12/defconfig
```kconfig
# CONFIG_PACKAGE_kmod-mt7992-23-firmware is not set
# CONFIG_PACKAGE_kmod-mt7992-firmware is not set
# CONFIG_PACKAGE_kmod-mt7996-233-firmware is not set
# CONFIG_PACKAGE_kmod-mt7996-firmware is not set
```

## autobuild/unified/filogic/mac80211/mt7988_rfb/24.10/defconfig
```kconfig
# CONFIG_TARGET_DEVICE_mediatek_filogic_DEVICE_mediatek_mt7981-rfb is not set
# CONFIG_TARGET_DEVICE_mediatek_filogic_DEVICE_mediatek_mt7986a-rfb-nand is not set
CONFIG_TARGET_DEVICE_mediatek_filogic_DEVICE_mediatek_mt7988d-rfb=y
# CONFIG_TARGET_DEVICE_mediatek_filogic_DEVICE_mediatek_mt7986b-rfb is not set
CONFIG_PACKAGE_aqr10g-phy-firmware=y
CONFIG_PACKAGE_kmod-usb3=y
CONFIG_PACKAGE_e2fsprogs=y
CONFIG_PACKAGE_f2fsck=y
CONFIG_PACKAGE_mkf2fs=y
CONFIG_PACKAGE_spidev-test=y
```

## autobuild/unified/filogic/mac80211/mt7988_rfb/25.12/defconfig
```kconfig
# CONFIG_TARGET_DEVICE_mediatek_filogic_DEVICE_bananapi_bpi-r4-lite is not set
# CONFIG_TARGET_DEVICE_mediatek_filogic_DEVICE_mediatek_mt7987a-rfb is not set
CONFIG_PACKAGE_aqr10g-phy-firmware=y
CONFIG_PACKAGE_kmod-gpio-pca953x=m
CONFIG_PACKAGE_kmod-gpio-pcf857x=y
CONFIG_PACKAGE_kmod-hwmon-ina2xx=y
CONFIG_PACKAGE_kmod-usb3=y
CONFIG_PACKAGE_blkid=y
CONFIG_PACKAGE_e2fsprogs=y
CONFIG_PACKAGE_f2fsck=y
CONFIG_PACKAGE_mkf2fs=y
```

## autobuild/unified/filogic/mac80211/mt7988_rfb/mt7992/24.10/defconfig
```kconfig
# CONFIG_TARGET_DEVICE_mediatek_filogic_DEVICE_mediatek_mt7981-rfb is not set
# CONFIG_TARGET_DEVICE_mediatek_filogic_DEVICE_mediatek_mt7986a-rfb-nand is not set
# CONFIG_TARGET_DEVICE_mediatek_filogic_DEVICE_mediatek_mt7986b-rfb is not set
CONFIG_PACKAGE_aqr10g-phy-firmware=y
# CONFIG_PACKAGE_mt7981-wo-firmware is not set
# CONFIG_PACKAGE_mt7986-wo-firmware is not set
CONFIG_PACKAGE_kmod-usb3=y
# CONFIG_PACKAGE_kmod-mt7915e is not set
# CONFIG_PACKAGE_kmod-mt7981-firmware is not set
# CONFIG_PACKAGE_kmod-mt7986-firmware is not set
# CONFIG_PACKAGE_kmod-mt7996-233-firmware is not set
# CONFIG_PACKAGE_kmod-mt7996-firmware is not set
CONFIG_PACKAGE_e2fsprogs=y
CONFIG_PACKAGE_f2fsck=y
CONFIG_PACKAGE_mkf2fs=y
```

## autobuild/unified/filogic/mac80211/mt7988_rfb/mt7992/25.12/defconfig
```kconfig
# CONFIG_PACKAGE_kmod-mt7990-firmware is not set
# CONFIG_PACKAGE_kmod-mt7996-233-firmware is not set
# CONFIG_PACKAGE_kmod-mt7996-firmware is not set
```

## autobuild/unified/filogic/mac80211/mt7988_rfb/mt7996/master/defconfig
```kconfig
# CONFIG_PACKAGE_kmod-mt7990-firmware is not set
# CONFIG_PACKAGE_kmod-mt7992-23-firmware is not set
# CONFIG_PACKAGE_kmod-mt7992-firmware is not set
```

## autobuild/unified/filogic/mac80211/mt798x_rfb/25.12/defconfig
```kconfig
CONFIG_TARGET_PER_DEVICE_ROOTFS=y
CONFIG_PACKAGE_aqr10g-phy-firmware=y
CONFIG_PACKAGE_kmod-sfp=y
CONFIG_PACKAGE_kmod-usb3=y
CONFIG_PACKAGE_blkid=y
CONFIG_PACKAGE_e2fsprogs=y
CONFIG_PACKAGE_f2fsck=y
CONFIG_PACKAGE_mkf2fs=y
```
