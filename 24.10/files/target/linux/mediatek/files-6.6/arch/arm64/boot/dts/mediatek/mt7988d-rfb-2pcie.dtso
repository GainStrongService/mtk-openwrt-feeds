// SPDX-License-Identifier: (GPL-2.0 OR MIT)
/*
 * Copyright (C) 2025 MediaTek Inc.
 * Author: Sam.Shih <sam.shih@mediatek.com>
 */

/dts-v1/;
/plugin/;

#include <dt-bindings/gpio/gpio.h>

/ {
	/*
	 * Making MT7988A PCIE working like MT7988D, which only support 2 pcies:
	 * -pcie0: pcie@11300000 - Gen3 2 lanes
	 * -pcie3: pcie@11290000 - Gen3 1 lane
	 */

	fragment@0 {
		target-path = "/soc/pcie@11280000";
		__overlay__ {
			status = "disabled";
		};
	};

	fragment@1 {
		target-path = "/soc/pcie@11310000";
		__overlay__ {
			status = "disabled";
		};
	};

	/*
	 * For 2-PCIe WiFi NICs like MT7996, MT7988D uses PCIe0 and PCIe3,
	 * while MT7988A uses PCIe0 and PCIe1; since the PCIe probe order is
	 * PCIe2-PCIe3-PCIe0-PCIe1, we should add a reset node to PCIe3 here.
	 * When both PCIe3 and PCIe0 have a reset node, PCIe3 (probed first)
	 * acquires the GPIO, PCIe0 gets -EBUSY, but since the PCIe driver
	 * requests GPIOs optionally, everything works as expected.
	 */

	fragment@2 {
		target-path = "/soc/pcie@11290000";
		__overlay__ {
			wifi-reset-gpios = <&pio 7 GPIO_ACTIVE_LOW>;
			wifi-reset-msleep = <100>;
			status = "okay";
		};
	};
};

